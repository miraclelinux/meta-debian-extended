## conf/layer.conf
```bitbake
# We have a conf and classes directory, add to BBPATH
BBPATH .= ":${LAYERDIR}"

# We have recipes-* directories, add to BBFILES
BBFILES += "${LAYERDIR}/recipes-*/*/*.bb \
            ${LAYERDIR}/recipes-*/*/*.bbappend"

BBFILE_COLLECTIONS += "debian-extended"
BBFILE_PATTERN_debian-extended = "^${LAYERDIR}/"
BBFILE_PRIORITY_debian-extended = "11"

LAYERDEPENDS_debian-extended = "core debian"
LAYERSERIES_COMPAT_debian-extended = "warrior"

LAYERDIR_DEBIAN_debian-extended = '${@os.path.normpath("${LAYERDIR}")}'

LICENSE_PATH += "${LAYERDIR}/licenses"
```
